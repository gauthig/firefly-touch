## hvac_capture/main/Kconfig.projbuild
```kconfig
menu "Firefly EasyTouch Capture"

    config FIREFLY_EASYTOUCH_PASSWORD
        string "Micro-Air account password"
        default ""
        help
            The password of the Micro-Air account already paired to the
            coach's EasyTouch thermostat (the same one the phone app uses
            to connect over Bluetooth). This is the ONLY credential the
            protocol uses -- there is no separate BLE pairing. See
            docs/EASYTOUCH-THERMOSTAT.md section 2.

            Set this in THIS project's own sdkconfig only
            (hvac_capture/sdkconfig) -- never in sdkconfig.defaults, same
            handling as every other real secret in this repo (battery MACs,
            ESP-NOW peer MAC/PMK/LMK).

    config FIREFLY_EASYTOUCH_EMAIL
        string "Micro-Air account e-mail (optional)"
        default ""
        help
            Sent as the "EM" field on a Get Status request if non-empty.
            The design's recommendation (docs/EASYTOUCH-THERMOSTAT.md
            section 3.3) is to leave this and the timestamp out, since the
            thermostat sets its clock from a connecting app's timestamp and
            this capture tool has no clock to give it. Leave blank unless
            bench step 2 (status with vs. without EM/TM) needs to compare.

    config FIREFLY_EASYTOUCH_NAME_PREFIX
        string "Advertised name prefix to scan for"
        default "EasyTouch"
        help
            The thermostat advertises as "EasyTouch <serial>". Prefix match
            is fine for a single thermostat in range.

    config FIREFLY_EASYTOUCH_POLL_INTERVAL_MS
        int "Status poll interval (ms)"
        default 5000
        range 2000 60000
        help
            Bench-capture cadence, deliberately fast (not the eventual
            gateway's 20-30 s production interval) so a mode change made on
            the touchscreen shows up in the log quickly during a capture
            session.

endmenu
```

## valves/main/Kconfig.projbuild
```kconfig
menu "Firefly Valve Node"

    config FIREFLY_VALVE_SENSE_ENABLED
        bool "DI position sense circuits are wired (grey DI1 / black DI2)"
        default y
        help
            The sense circuits (2N3904 divider, docs/DRAINMASTER-VALVES.md
            #4) are built and were verified on both real valves 2026-10-16,
            so this defaults on. Turn it off only on a bench node with no
            sense wiring.

            With it on, the reported position FOLLOWS THE SENSOR -- a valve
            moved by the wall rocker shows up on the panel too -- and CLOSE
            is closed-loop on DI.

            While off, CLOSE is a TIMED drive exactly like OPEN: it runs
            for VALVE_DRIVE_NOMINAL_MS (1 s) and is then assumed to have
            succeeded, reported CLOSED, rather than polling DI1/DI2 (which
            float with no sense circuit connected -- confirmed on the
            bench 2026-09-04: one channel never read "closed" and timed
            out to unknown every time, the other happened to float
            "closed" from boot and reported success almost instantly,
            neither reflecting anything real). Startup position is also
            not seeded from DI while this is off -- both valves start
            unknown rather than trusting a floating reading.

            Turn this on once DI1/DI2 are wired for real -- CLOSE then
            goes back to polling and either confirms within the drive
            ceiling or reports unknown and gives up, per docs/
            DRAINMASTER-VALVES.md #7.

    config FIREFLY_VALVE_DI_ACTIVE_LOW
        bool "DI GPIO reads LOW when the valve is fully closed"
        default y
        help
            The sense front-end sinks the board's opto input when the valve
            is closed (docs/DRAINMASTER-VALVES.md #4). MEASURED 2026-10-16 on
            the real valves with the sensor test: the GPIO reads LOW (0)
            when fully closed and HIGH (1) when not closed, so this is on.
            (The docs had assumed the opposite.) If you ever change the
            sense front-end, re-run FIREFLY_VALVE_SENSE_TEST and match the
            "raw=" level the log shows with the valve closed.

    config FIREFLY_VALVE_SENSE_TEST
        bool "Sensor test build: log DI1/DI2 and never drive a relay"
        default n
        help
            Read-only bench/coach test for the position-sense circuits. The
            node logs the raw and interpreted level of DI1 (grey) and DI2
            (black) on every change and once a second, and DROPS every
            ESP-NOW drive command, so no relay can be energized from this
            build. Use it with the magnet test and the wall rocker.

    config FIREFLY_VALVE_TEST_MODE
        bool "Run bench self-test sequence on boot"
        default n
        help
            Runs the DRAINMASTER-VALVES.md bring-up order steps 1-3 on
            every boot: clicks each of the 8 relays individually, attempts
            a deliberately unsafe mask and confirms the interlock refuses
            it, then proves the independent watchdog releases the relays
            even when the driving code doesn't call release itself.

            Safe with no valve or sense wiring connected — everything here
            is a relay click and an I2C readback. Defaults off now that
            real ESP-NOW-driven valve control exists (valve_drive.c) --
            leave it off in production so a routine power-cycle doesn't
            click every relay before going idle. Still useful to re-enable
            for bench debugging.

    menu "ESP-NOW (mid_coach is this node's one peer)"

        config FIREFLY_ESPNOW_CHANNEL
            int "ESP-NOW WiFi channel"
            default 1
            range 1 13
            help
                Must match mid_coach's channel exactly -- there is no AP to
                negotiate one.

        config FIREFLY_ESPNOW_PEER_MAC
            string "mid_coach's ESP-NOW MAC address (AA:BB:CC:DD:EE:FF)"
            default "AA:BB:CC:DD:EE:FF"
            help
                mid_coach's MAC. Must equal mid_coach's own
                CONFIG_FIREFLY_ESPNOW_VALVE_PEER_MAC -- that symbol, not
                CONFIG_FIREFLY_ESPNOW_PEER_MAC, since this node is
                mid_coach's SECOND peer (bedroom_remote is the first).

        config FIREFLY_ESPNOW_PMK
            string "ESP-NOW primary master key (16 ASCII chars)"
            default "firefly-pmk-0001"
            help
                Shared network-wide. Must equal every panel's
                CONFIG_FIREFLY_ESPNOW_PMK. CHANGE THIS before deploying --
                these frames actuate real loads.

        config FIREFLY_ESPNOW_LMK
            string "ESP-NOW peer local master key (16 ASCII chars)"
            default "firefly-valve-lmk-01"
            help
                Must equal mid_coach's CONFIG_FIREFLY_ESPNOW_VALVE_LMK
                specifically (a different key from the bedroom_remote
                pair's). CHANGE THIS before deploying.

        config FIREFLY_ESPNOW_VALVE_PEER_MAC
            string "unused by this node"
            default "AA:BB:CC:DD:EE:FF"
            help
                Not used. This node has exactly one peer (mid_coach, above)
                added the normal way via espnow_link_init(). The
                "valve peer" concept in espnow_link.c is mid_coach's SECOND
                peer, added by espnow_link_add_valve_peer() -- a function
                this node never calls. The symbol exists only because
                espnow_link.c references it unconditionally at compile
                time. Leave it at the placeholder.

        config FIREFLY_ESPNOW_VALVE_LMK
            string "unused by this node"
            default "firefly-lmk-0001"
            help
                Same as FIREFLY_ESPNOW_VALVE_PEER_MAC above -- unused,
                exists only so espnow_link.c compiles.

        config FIREFLY_VALVE_RESYNC_INTERVAL_MS
            int "Valve status resync broadcast interval (ms)"
            default 15000
            range 5000 120000
            help
                How often this node re-sends its current position for both
                valves even without a state change, so a panel reboot or a
                missed frame self-heals (mirrors mid_coach's own
                ESPNOW_RESYNC_PERIOD_MS for dimmer status). Keep in step
                with mid_coach's CONFIG_FIREFLY_VALVE_RESYNC_INTERVAL_MS,
                which derives its staleness window from this value (3x).

    endmenu

endmenu
```
